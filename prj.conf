## CMakeLists.txt
```
cmake_minimum_required(VERSION 3.20.0)

# Send printk output over USB, because the Pico has no other console on its USB port.
list(APPEND SNIPPET cdc-acm-console)

find_package(Zephyr REQUIRED HINTS $ENV{ZEPHYR_BASE})
project(zephyr_lab)

target_sources(app PRIVATE src/main.c src/counter.c)
target_include_directories(app PRIVATE inc)
```

## prj.conf
```kconfig
# Run main below the USB driver's thread (priority 8), so a busy main cannot stall USB.
CONFIG_MAIN_THREAD_PRIORITY=10

# Keep __ASSERT() checks in the image, ours and the kernel's, so misuse such as locking a mutex in an interrupt halts with a message.
CONFIG_ASSERT=y
```

## src/main.c
```c
#include <zephyr/kernel.h>
#include <zephyr/sys/printk.h>
#include "counter.h"
#include "zephyr_lab.h"

static K_SEM_DEFINE(worker_wake, 0, 1);

static void on_timer(struct k_timer *timer)
{
	ARG_UNUSED(timer);

	k_sem_give(&worker_wake);
}

static K_TIMER_DEFINE(worker_timer, on_timer, NULL);

static void worker(void *p1, void *p2, void *p3)
{
	ARG_UNUSED(p1);
	ARG_UNUSED(p2);
	ARG_UNUSED(p3);

	while (1)
	{
		(void)k_sem_take(&worker_wake, K_FOREVER);
		counter_add(COUNTER_WORKER);
	}
}

K_THREAD_DEFINE(worker_tid, WORKER_STACK_SIZE, worker, NULL, NULL, NULL,
		WORKER_PRIORITY, 0, 0);

static void report(void)
{
	static uint32_t timer_fires;
	struct counter_snapshot now;
	uint32_t total;

	counter_read(&now);
	timer_fires += k_timer_status_get(&worker_timer);
	total = now.adds[COUNTER_MAIN] + now.adds[COUNTER_WORKER];

	printk("main %u + worker %u = %u, shared %u, lost %u, timer %u\n",
	       now.adds[COUNTER_MAIN], now.adds[COUNTER_WORKER], total,
	       now.shared, total - now.shared, timer_fires);
}

int main(void)
{
	int64_t next_report = REPORT_PERIOD_MS;

	k_timer_start(&worker_timer, K_MSEC(WORKER_PERIOD_MS),
		      K_MSEC(WORKER_PERIOD_MS));

	while (1)
	{
		counter_add(COUNTER_MAIN);

		if (k_uptime_get() >= next_report)
		{
			report();
			next_report += REPORT_PERIOD_MS;
		}

		k_msleep(MAIN_PERIOD_MS);
	}
	return 0;
}
```

## inc/counter.h
```c
#ifndef COUNTER_H
#define COUNTER_H

#include <stdint.h>

enum counter_source
{
	COUNTER_MAIN,
	COUNTER_WORKER,
	COUNTER_SOURCES
};

struct counter_snapshot
{
	uint32_t shared;
	uint32_t adds[COUNTER_SOURCES];
};

void counter_add(enum counter_source source);
void counter_read(struct counter_snapshot *out);

#endif
```

## inc/zephyr_lab.h
```c
#ifndef ZEPHYR_LAB_H
#define ZEPHYR_LAB_H

#define MAIN_PERIOD_MS		7
#define REPORT_PERIOD_MS	1000

#define WORKER_STACK_SIZE	1024
#define WORKER_PRIORITY		11
#define WORKER_PERIOD_MS	2

#define INCREMENT_DELAY_US	1000

#endif
```

## src/counter.c
```c
#include <zephyr/kernel.h>
#include "counter.h"
#include "zephyr_lab.h"

static uint32_t shared_count;
static uint32_t adds[COUNTER_SOURCES];

static K_MUTEX_DEFINE(count_lock);

void counter_add(enum counter_source source)
{
	uint32_t value;

	__ASSERT(source < COUNTER_SOURCES, "bad source %d", source);

	(void)k_mutex_lock(&count_lock, K_FOREVER);

	value = shared_count;
	k_busy_wait(INCREMENT_DELAY_US);
	shared_count = value + 1;
	adds[source]++;

	(void)k_mutex_unlock(&count_lock);
}

void counter_read(struct counter_snapshot *out)
{
	(void)k_mutex_lock(&count_lock, K_FOREVER);

	out->shared = shared_count;
	for (int i = 0; i < COUNTER_SOURCES; i++)
		out->adds[i] = adds[i];

	(void)k_mutex_unlock(&count_lock);
}
```
